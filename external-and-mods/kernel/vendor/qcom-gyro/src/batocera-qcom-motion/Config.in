## external-and-mods/kernel/vendor/qcom-gyro/src/batocera-qcom-motion/Config.in
```kconfig
config BR2_PACKAGE_BATOCERA_QCOM_MOTION
	bool "batocera-qcom-motion"
	depends on BR2_PACKAGE_BATOCERA_TARGET_SM8550
	select BR2_PACKAGE_LIBSSC
	select BR2_PACKAGE_PYTHON3
	select BR2_PACKAGE_PYTHON_PYXEL
	select BR2_PACKAGE_ZLIB
	help
	  Expose Qualcomm Sensor Core accelerometer and gyroscope data as a
	  local DSU/Cemuhook motion controller for emulators. Includes a
	  controller-friendly gyro and five-pose accelerometer calibrator.
```

## external-and-mods/kernel/vendor/qcom-gyro/src/hexagonrpc/Config.in
```kconfig
config BR2_PACKAGE_HEXAGONRPC
	bool "hexagonrpc"
	depends on BR2_aarch64
	select BR2_PACKAGE_JSON_C
	help
	  Linux userspace FastRPC listener and filesystem service for Qualcomm
	  Hexagon DSPs. This also installs sscregistrygen for preparing a QSH
	  sensor registry from Android sensor configuration files.

	  https://github.com/linux-msm/hexagonrpc
```

## external-and-mods/kernel/vendor/qcom-gyro/src/libssc/Config.in
```kconfig
config BR2_PACKAGE_LIBSSC
	bool "libssc"
	depends on BR2_aarch64
	depends on BR2_USE_WCHAR
	depends on BR2_TOOLCHAIN_HAS_THREADS
	depends on BR2_USE_MMU
	depends on BR2_INSTALL_LIBSTDCPP
	select BR2_PACKAGE_LIBGLIB2
	select BR2_PACKAGE_LIBQRTR_GLIB
	select BR2_PACKAGE_LIBQMI
	select BR2_PACKAGE_PROTOBUF_C
	help
	  GLib library exposing accelerometer, gyroscope and other sensors
	  managed by the Qualcomm Sensor Core over QMI/QRTR.

	  https://codeberg.org/DylanVanAssche/libssc
```
